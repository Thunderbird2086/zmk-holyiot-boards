## board/arm/holyiot_18010/Kconfig.board
```kconfig
config BOARD_HOLYIOT_18010
    bool "Holyiot 18010 Dongle"
    depends on SOC_NRF52840_QIAA
```

## board/arm/holyiot_18010/holyiot_18010_defconfig
```kconfig
CONFIG_SOC_SERIES_NRF52X=y
CONFIG_SOC_NRF52840_QIAA=y
CONFIG_BOARD_HOLYIOT_18010=y

CONFIG_HAS_NORDIC_SOFTDEVICE=y
CONFIG_BUILD_OUTPUT_HEX=y

CONFIG_ZMK_USB=y
CONFIG_GPIO=y
```

## boards/arm/holyiot_18010/Kconfig.holyiot_18010
```kconfig
# Holyiot 18010 Dongle board configuration
#
# SPDX-License-Identifier: MIT

config BOARD_HOLYIOT_18010
	bool
	select SOC_NRF52840_QIAA
```

## boards/holyiot/yj17120/Kconfig.yj17120
```kconfig
# SPDX-License-Identifier: Apache-2.0

config BOARD_YJ17120
    select SOC_NRF52840_QIAA
    select ZMK_BOARD_COMPAT
```

## boards/holyiot/yj17120/board.yml
```yaml
board:
  name: yj17120
  full_name: Holyiot YJ-17120 (nRF52840)
  vendor: holyiot
  socs:
    - name: nrf52840
      variants:
        - name: zmk
```

## boards/shields/yj17120_tester/Kconfig.defconfig
```kconfig
# SPDX-License-Identifier: Apache-2.0

if SHIELD_YJ17120_TESTER

config ZMK_KEYBOARD_NAME
    default "YJ17120 Tester"

config ZMK_KSCAN_MATRIX_POLLING
    default y

config ZMK_SPLIT
    default n

endif
```

## boards/shields/yj17120_tester/Kconfig.shield
```kconfig
# SPDX-License-Identifier: Apache-2.0

config SHIELD_YJ17120_TESTER
    def_bool $(shields_list_contains,yj17120_tester)
```
