#include <behaviors.dtsi>
#include <dt-bindings/zmk/keys.h>

/ {
    keymap {
        compatible = "zmk,keymap";

        /*
         * HolyIOT YJ-17120 is a keyless BLE central dongle.
         * Keys arrive from paired split peripherals; no local layout.
         * A single no-op binding keeps the keymap subsystem bound.
         */
        default_layer {
            bindings = <
                &none
            >;
        };
    };
};
